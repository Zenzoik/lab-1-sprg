#include "platform.h"

#include <stdint.h>

#include "board.h"

/* ---------------------------------------------------------------- I2C */

static uint32_t g_i2c_diag;

static uint32_t i2c_last_error(void) {
  return g_i2c_diag;
}

static uint32_t i2c_status_reg(void) {
  return BOARD_I2C->Instance->ISR;
}

/* Polling master transfer written against the reference manual (RM0490, I2C "master
 * transmitter / receiver" flow) instead of HAL_I2C_Master_Transmit/_Receive/Mem_Read:
 * the HAL for STM32C0 preloads TXDR before START, and the Wokwi I2C model then never raises
 * TXIS for the second byte (see docs/lab2-report.md, problem log). Peripheral set-up
 * (clocks, timing, filters, pins) is still done by the HAL (MX_I2C1_Init + MSP). */
static bus_status_t i2c_wait(I2C_TypeDef *i2c, uint32_t flag, uint32_t t0) {
  while ((i2c->ISR & flag) == 0u) {
    if ((i2c->ISR & I2C_ISR_NACKF) != 0u) {
      return BUS_ERR_NACK;
    }
    if ((HAL_GetTick() - t0) > BOARD_I2C_TIMEOUT_MS) {
      return BUS_ERR_TIMEOUT;
    }
  }
  return BUS_OK;
}

static void i2c_start(I2C_TypeDef *i2c, uint16_t addr8, size_t n, uint32_t mode) {
  i2c->CR2 = ((uint32_t)addr8 & I2C_CR2_SADD) | ((uint32_t)n << I2C_CR2_NBYTES_Pos) | mode | I2C_CR2_START;
}

/* Finish a transfer: wait for STOP (generated by AUTOEND or by NACK), clear flags. */
static bus_status_t i2c_finish(I2C_TypeDef *i2c, bus_status_t st, uint32_t t0) {
  if (st != BUS_OK) {
    i2c->CR2 |= I2C_CR2_STOP; /* NACK / timeout: terminate the transfer ourselves */
  }
  while ((i2c->ISR & I2C_ISR_STOPF) == 0u) {
    if ((HAL_GetTick() - t0) > BOARD_I2C_TIMEOUT_MS) {
      st = (st == BUS_OK) ? BUS_ERR_TIMEOUT : st;
      break;
    }
  }
  i2c->ICR = I2C_ICR_STOPCF | I2C_ICR_NACKCF;
  i2c->CR2 = 0u;
  if (st == BUS_ERR_TIMEOUT) {
    i2c->CR1 &= ~I2C_CR1_PE; /* abandon the transfer: reset the state machine */
    i2c->CR1 |= I2C_CR1_PE;
  }
  return st;
}

static bus_status_t i2c_hw_write(I2C_TypeDef *i2c, uint16_t addr8, const uint8_t *tx, size_t len, uint32_t t0) {
  bus_status_t st = BUS_OK;
  i2c_start(i2c, addr8, len, I2C_CR2_AUTOEND);
  for (size_t k = 0; k < len && st == BUS_OK; k++) {
    st = i2c_wait(i2c, I2C_ISR_TXIS, t0);
    if (st == BUS_OK) {
      i2c->TXDR = tx[k];
    }
  }
  return i2c_finish(i2c, st, t0);
}

static bus_status_t i2c_hw_read(I2C_TypeDef *i2c, uint16_t addr8, uint8_t *rx, size_t len, uint32_t t0) {
  bus_status_t st = BUS_OK;
  i2c_start(i2c, addr8, len, I2C_CR2_AUTOEND | I2C_CR2_RD_WRN);
  for (size_t k = 0; k < len && st == BUS_OK; k++) {
    st = i2c_wait(i2c, I2C_ISR_RXNE, t0);
    if (st == BUS_OK) {
      rx[k] = (uint8_t)i2c->RXDR;
    }
  }
  return i2c_finish(i2c, st, t0);
}

static bus_status_t i2c_xfer(void *ctx, uint8_t addr7, const uint8_t *tx, size_t len, uint8_t *rx,
                             size_t rlen) {
  I2C_HandleTypeDef *h = (I2C_HandleTypeDef *)ctx;
  I2C_TypeDef *i2c = h->Instance;
  const uint16_t addr8 = (uint16_t)((uint16_t)addr7 << 1);
  const uint32_t t0 = HAL_GetTick();
  bus_status_t st = BUS_OK;

  if ((len > 255u) || (rlen > 255u) || (len == 0u && rlen == 0u)) {
    return BUS_ERR_IO;
  }
#if BOARD_I2C_RESET_BEFORE_XFER
  /* Simulator workaround: Wokwi's I2C model loses the second TXIS of a multi-byte write unless
   * the peripheral state machine was reset first (PE 1 -> 0 -> 1 keeps timing/filters). */
  i2c->CR1 &= ~I2C_CR1_PE;
  i2c->CR1 |= I2C_CR1_PE;
#endif
  while ((i2c->ISR & I2C_ISR_BUSY) != 0u) {
    if ((HAL_GetTick() - t0) > BOARD_I2C_TIMEOUT_MS) {
      /* Bus stuck busy (e.g. a previous transfer was abandoned): software-reset the peripheral
       * (RM0490: clearing PE resets the state machine and the BUSY flag) and report the error. */
      i2c->CR1 &= ~I2C_CR1_PE;
      i2c->CR1 |= I2C_CR1_PE;
      g_i2c_diag = ((uint32_t)BUS_ERR_TIMEOUT << 16) | (i2c->ISR & 0xFFFFu);
      return BUS_ERR_TIMEOUT;
    }
  }
  if (len > 0u && rlen == 0u) {
    st = i2c_hw_write(i2c, addr8, tx, len, t0);
  } else if (len == 0u) {
    st = i2c_hw_read(i2c, addr8, rx, rlen, t0);
  } else {
#if BOARD_I2C_REPEATED_START
    /* START, addr+W, reg, REPEATED START, addr+R, data..., STOP (datasheet burst-read figure). */
    i2c_start(i2c, addr8, len, 0u); /* SOFTEND: TC is set after the last byte, no STOP */
    for (size_t k = 0; k < len && st == BUS_OK; k++) {
      st = i2c_wait(i2c, I2C_ISR_TXIS, t0);
      if (st == BUS_OK) {
        i2c->TXDR = tx[k];
      }
    }
    if (st == BUS_OK) {
      st = i2c_wait(i2c, I2C_ISR_TC, t0);
    }
    if (st == BUS_OK) {
      i2c_start(i2c, addr8, rlen, I2C_CR2_AUTOEND | I2C_CR2_RD_WRN);
      for (size_t k = 0; k < rlen && st == BUS_OK; k++) {
        st = i2c_wait(i2c, I2C_ISR_RXNE, t0);
        if (st == BUS_OK) {
          rx[k] = (uint8_t)i2c->RXDR;
        }
      }
    }
    st = i2c_finish(i2c, st, t0);
#else
    st = i2c_hw_write(i2c, addr8, tx, len, t0);
    if (st == BUS_OK) {
      st = i2c_hw_read(i2c, addr8, rx, rlen, t0);
    }
#endif
  }
  g_i2c_diag = ((uint32_t)st << 16) | (i2c->ISR & 0xFFFFu);
  return st;
}

static bus_status_t i2c_probe(void *ctx, uint8_t addr7) {
  I2C_HandleTypeDef *h = (I2C_HandleTypeDef *)ctx;
  const HAL_StatusTypeDef s = HAL_I2C_IsDeviceReady(h, (uint16_t)((uint16_t)addr7 << 1), 1, BOARD_I2C_TIMEOUT_MS);
  if (s == HAL_OK) {
    return BUS_OK;
  }
  if (s == HAL_TIMEOUT) {
    return BUS_ERR_TIMEOUT;
  }
  return (s == HAL_BUSY) ? BUS_ERR_IO : BUS_ERR_NACK;
}

static const i2c_bus_t k_i2c = {.ctx = NULL, .xfer = i2c_xfer, .probe = i2c_probe};

/* ---------------------------------------------------------------- SPI */

static bus_status_t spi_xfer(void *ctx, const uint8_t *tx, uint8_t *rx, size_t len) {
  SPI_HandleTypeDef *h = (SPI_HandleTypeDef *)ctx;
  static const uint8_t k_ff[16] = {0xFF, 0xFF, 0xFF, 0xFF, 0xFF, 0xFF, 0xFF, 0xFF,
                                   0xFF, 0xFF, 0xFF, 0xFF, 0xFF, 0xFF, 0xFF, 0xFF};
  HAL_StatusTypeDef s = HAL_OK;
  if (tx != NULL && rx != NULL) {
    s = HAL_SPI_TransmitReceive(h, (uint8_t *)(uintptr_t)tx, rx, (uint16_t)len, BOARD_SPI_TIMEOUT_MS);
  } else if (tx != NULL) {
    s = HAL_SPI_Transmit(h, (uint8_t *)(uintptr_t)tx, (uint16_t)len, BOARD_SPI_TIMEOUT_MS);
  } else if (rx != NULL) {
    size_t done = 0;
    while (done < len && s == HAL_OK) {
      const size_t n = ((len - done) < sizeof k_ff) ? (len - done) : sizeof k_ff;
      s = HAL_SPI_TransmitReceive(h, (uint8_t *)(uintptr_t)k_ff, &rx[done], (uint16_t)n, BOARD_SPI_TIMEOUT_MS);
      done += n;
    }
  }
  if (s == HAL_OK) {
    return BUS_OK;
  }
  return (s == HAL_TIMEOUT) ? BUS_ERR_TIMEOUT : BUS_ERR_IO;
}

static void spi_cs(void *ctx, int level) {
  (void)ctx;
  HAL_GPIO_WritePin(BOARD_FLASH_CS_PORT, BOARD_FLASH_CS_PIN, level ? GPIO_PIN_SET : GPIO_PIN_RESET);
}

static const spi_bus_t k_spi = {.ctx = NULL, .transfer = spi_xfer, .cs = spi_cs};

static int spi_set_mode(unsigned mode) {
  if (mode > 3u) {
    return -1;
  }
  BOARD_SPI->Init.CLKPolarity = (mode & 2u) ? SPI_POLARITY_HIGH : SPI_POLARITY_LOW;
  BOARD_SPI->Init.CLKPhase = (mode & 1u) ? SPI_PHASE_2EDGE : SPI_PHASE_1EDGE;
  return (HAL_SPI_Init(BOARD_SPI) == HAL_OK) ? 0 : -1;
}

/* ---------------------------------------------------------------- console */

static void uart_write(const char *s, size_t n) {
  (void)HAL_UART_Transmit(BOARD_UART, (uint8_t *)(uintptr_t)s, (uint16_t)n, BOARD_UART_TX_TIMEOUT_MS);
}

static int uart_read_char(void) {
  UART_HandleTypeDef *u = BOARD_UART;
  if (__HAL_UART_GET_FLAG(u, UART_FLAG_ORE) != RESET) {
    __HAL_UART_CLEAR_OREFLAG(u);
  }
  if (__HAL_UART_GET_FLAG(u, UART_FLAG_RXNE) != RESET) {
    return (int)(u->Instance->RDR & 0xFFu);
  }
  return -1;
}

/* newlib hook: printf() -> USART2 (kept for debugging; the app uses uart_write) */
int _write(int fd, char *p, int n) {
  (void)fd;
  uart_write(p, (size_t)n);
  return n;
}

/* ---------------------------------------------------------------- misc I/O */

static uint32_t clock_millis(void) {
  return HAL_GetTick();
}

static void clock_delay_ms(uint32_t ms) {
  HAL_Delay(ms);
}

static int adc_read(uint16_t *raw12) {
  int rc = -1;
  if (HAL_ADC_Start(BOARD_ADC) == HAL_OK) {
    if (HAL_ADC_PollForConversion(BOARD_ADC, BOARD_ADC_TIMEOUT_MS) == HAL_OK) {
      *raw12 = (uint16_t)HAL_ADC_GetValue(BOARD_ADC);
      rc = 0;
    }
    (void)HAL_ADC_Stop(BOARD_ADC);
  }
  return rc;
}

static int button_pressed(void) {
  return HAL_GPIO_ReadPin(BOARD_BUTTON_PORT, BOARD_BUTTON_PIN) == GPIO_PIN_RESET;
}

static void led_write(int on) {
  HAL_GPIO_WritePin(BOARD_LED_PORT, BOARD_LED_PIN, on ? GPIO_PIN_SET : GPIO_PIN_RESET);
}

static void marker(int level) {
  HAL_GPIO_WritePin(BOARD_MARKER_PORT, BOARD_MARKER_PIN, level ? GPIO_PIN_SET : GPIO_PIN_RESET);
}

/* TIM3 runs at 1 MHz (PSC = 47 on 48 MHz), ARR = 19999 -> 50 Hz; CCR = pulse in us. */
static uint32_t pwm_channel(unsigned ch) {
  return (ch == 1u) ? TIM_CHANNEL_1 : TIM_CHANNEL_2;
}

static void pwm_set_us(unsigned ch, uint16_t us) {
  __HAL_TIM_SET_COMPARE(BOARD_PWM_TIM, pwm_channel(ch), us);
}

static uint16_t pwm_get_us(unsigned ch) {
  return (uint16_t)__HAL_TIM_GET_COMPARE(BOARD_PWM_TIM, pwm_channel(ch));
}

/* ---------------------------------------------------------------- port table */

static i2c_bus_t g_i2c;
static spi_bus_t g_spi;
static app_ports_t g_ports;

void platform_init(void) {
  g_i2c = k_i2c;
  g_i2c.ctx = BOARD_I2C;
  g_spi = k_spi;
  g_spi.ctx = BOARD_SPI;

  /* ADC: self-calibration (RM0490: required once after power-up, before the first conversion). */
  (void)HAL_ADCEx_Calibration_Start(BOARD_ADC);

  /* Servo outputs start centred. */
  (void)HAL_TIM_PWM_Start(BOARD_PWM_TIM, TIM_CHANNEL_1);
  (void)HAL_TIM_PWM_Start(BOARD_PWM_TIM, TIM_CHANNEL_2);
  pwm_set_us(1, 1500);
  pwm_set_us(2, 1500);

  /* Idle levels: CS# high, marker low, LED off. */
  spi_cs(NULL, 1);
  marker(0);
  led_write(0);

  g_ports = (app_ports_t){
      .i2c = &g_i2c,
      .spi = &g_spi,
      .write = uart_write,
      .read_char = uart_read_char,
      .millis = clock_millis,
      .delay_ms = clock_delay_ms,
      .i2c_last_error = i2c_last_error,
      .i2c_status_reg = i2c_status_reg,
      .adc_read = adc_read,
      .button_pressed = button_pressed,
      .led_write = led_write,
      .marker = marker,
      .pwm_set_us = pwm_set_us,
      .pwm_get_us = pwm_get_us,
      .spi_set_mode = spi_set_mode,
  };
}

const app_ports_t *platform_ports(void) {
  return &g_ports;
}
